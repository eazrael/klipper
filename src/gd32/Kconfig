## src/gd32/Kconfig
```kconfig
# Kconfig settings for GD32 processors

if MACH_GD32

config GD32_SELECT
    bool
    default y
    select HAVE_GPIO
    select HAVE_GPIO_ADC
    select HAVE_GPIO_HARD_PWM
    select HAVE_CHIPID
    select HAVE_STEPPER_OPTIMIZED_BOTH_EDGE
    select HAVE_BOOTLOADER_REQUEST
    select HAVE_LIMITED_CODE_SIZE if FLASH_SIZE < 0x10000

config BOARD_DIRECTORY
    string
    default "gd32"

######################################################################
# Chip selection
######################################################################

choice
    prompt "Processor model"
    config MACH_GD32F307
        bool "GD32F307"
        select MACH_GD32F3
endchoice

config MACH_GD32F3
    bool
# config HAVE_GD32_CANBUS
#     bool
#     default y

config MCU
    string
    default "gd32f307" if MACH_GD32F307

config CLOCK_FREQ
    int
    default 120000000 if MACH_GD32F3

# GD32F307 has 1MB flash; 0x40000 (256K) keeps the application in bank0,
# which avoids bank-switch complexity at runtime. The bootloader occupies
# the first 10K (0x2800); the status/config page is near the top of bank1
# (0x080fd000) and is handled separately by j1_bootloader.c.
config FLASH_SIZE
    hex
    default 0x40000

config FLASH_BOOT_ADDRESS
    hex
    default 0x8000000

config RAM_START
    hex
    default 0x20000000

config RAM_SIZE
    hex
    default 0x18000 if MACH_GD32F3

config STACK_SIZE
    int
    default 512

######################################################################
# Bootloader
######################################################################

choice
    prompt "Bootloader offset"
    # config GD32_FLASH_START_2000
    #     bool "8KiB bootloader" if MACH_GD32F1 || MACH_GD32F070 || MACH_GD32G0 || MACH_GD32G4 || MACH_GD32F0x2
    config GD32_FLASH_START_2800
        bool "10KiB bootloader" 
    config GD32_FLASH_START_0000
        bool "No bootloader"
endchoice

config FLASH_APPLICATION_ADDRESS
    hex
    default 0x8002800 if GD32_FLASH_START_2800
    default 0x8000000

config ARMCM_RAM_VECTORTABLE
    bool
    default y if FLASH_APPLICATION_ADDRESS != 0x8000000
    default n


######################################################################
# Clock
######################################################################

choice
    prompt "Clock Reference" if LOW_LEVEL_OPTIONS
    config GD32_CLOCK_SRC_INTERNAL
        bool "Internal clock"
#    config GD32_CLOCK_REF_8M
#        bool "8 MHz crystal"
#    config GD32_CLOCK_REF_12M
#        bool "12 MHz crystal"
#    config GD32_CLOCK_REF_16M
#        bool "16 MHz crystal"
#    config GD32_CLOCK_REF_20M
#        bool "20 MHz crystal"
#    config GD32_CLOCK_REF_24M
#        bool "24 MHz crystal"
    config GD32_CLOCK_SRC_HXTAL_25M
        bool "25 MHz crystal"
endchoice

config GD32_CLOCK_SRC
    string
    default __SYSTEM_CLOCK_120M_PLL_HXTAL if GD32_CLOCK_SRC_HXTAL_25M
    default __SYSTEM_CLOCK_120M_PLL_IRC8M if GD32_CLOCK_SRC_INTERNAL
    
# config CLOCK_REF_FREQ
#     int
#     default 25000000 if GD32_CLOCK_REF_25M
#     default 24000000 if GD32_CLOCK_REF_24M
#     default 20000000 if GD32_CLOCK_REF_20M
#     default 16000000 if GD32_CLOCK_REF_16M
#     default 12000000 if GD32_CLOCK_REF_12M
#     default 1 if GD32_CLOCK_REF_INTERNAL
#     default 8000000

######################################################################
# Communication inteface
######################################################################

choice
    prompt "Communication interface"
    config GD32_SERIAL_USART0
        bool "Serial (on USART0 PA10/PA9)"
        select SERIAL
    config GD32_SERIAL_USART0_ALT_PB7_PB6
        bool "Serial (on USART0 PB7/PB6)" if LOW_LEVEL_OPTIONS
        select SERIAL
    config GD32_SERIAL_USART1
        bool "Serial (on USART1 on PA3/PA2)" if LOW_LEVEL_OPTIONS
        select SERIAL
    config GD32_SERIAL_USART1_ALT_PD6_PD5
        bool "Serial (on USART1 PD6/PD5)" if LOW_LEVEL_OPTIONS
        select SERIAL
    config GD32_SERIAL_USART2
        bool "Serial (on USART2 on PB11/PB10)" if LOW_LEVEL_OPTIONS
        select SERIAL
    config GD32_SERIAL_USART2_ALT_PC11_PC10
        bool "Serial (on USART2 PC11/PC10)" if LOW_LEVEL_OPTIONS
        select SERIAL
    config GD32_SERIAL_USART2_ALT_PD9_PD8
        bool "Serial (on USART2 PD9/PD8)" if LOW_LEVEL_OPTIONS
        select SERIAL
endchoice

config GD32_SERIAL_DMA
    bool "Use DMA for serial communication" if LOW_LEVEL_OPTIONS
    depends on SERIAL
    default y
    help
        Transfer serial data with DMA instead of one interrupt per
        byte. Disable to fall back to the interrupt driven driver.

endif
```
