## config/snapmakerj1_defconfig
```kconfig
CONFIG_LOW_LEVEL_OPTIONS=y
# CONFIG_MACH_AVR is not set
# CONFIG_MACH_ATSAM is not set
# CONFIG_MACH_ATSAMD is not set
CONFIG_MACH_GD32=y
# CONFIG_MACH_LPC176X is not set
# CONFIG_MACH_STM32 is not set
# CONFIG_MACH_HC32F460 is not set
# CONFIG_MACH_RPXXXX is not set
# CONFIG_MACH_PRU is not set
# CONFIG_MACH_AR100 is not set
# CONFIG_MACH_LINUX is not set
# CONFIG_MACH_SIMU is not set
CONFIG_BOARD_DIRECTORY="gd32"
CONFIG_MCU="gd32f307"
CONFIG_CLOCK_FREQ=120000000
CONFIG_FLASH_SIZE=0x40000
CONFIG_FLASH_BOOT_ADDRESS=0x8000000
CONFIG_RAM_START=0x20000000
CONFIG_RAM_SIZE=0x18000
CONFIG_STACK_SIZE=512
CONFIG_FLASH_APPLICATION_ADDRESS=0x8002800
CONFIG_ARMCM_RAM_VECTORTABLE=y
CONFIG_GD32_SELECT=y
CONFIG_MACH_GD32F307=y
CONFIG_MACH_GD32F3=y
CONFIG_GD32F30X_CL=y
CONFIG_HAVE_GD32_USBFS=y
CONFIG_HAVE_GD32_USBOTG=y
CONFIG_GD32_FLASH_START_2800=y
# CONFIG_GD32_FLASH_START_0000 is not set
CONFIG_GD32_CLOCK_SRC_INTERNAL=y
# CONFIG_GD32_CLOCK_SRC_HXTAL_25M is not set
CONFIG_GD32_CLOCK_SRC="__SYSTEM_CLOCK_120M_PLL_IRC8M"
CONFIG_GD32F0_TRIM=16
# CONFIG_GD32_SERIAL_USART0 is not set
# CONFIG_GD32_SERIAL_USART0_ALT_PB7_PB6 is not set
# CONFIG_GD32_SERIAL_USART1 is not set
CONFIG_GD32_SERIAL_USART1_ALT_PD6_PD5=y
# CONFIG_GD32_SERIAL_USART2 is not set
# CONFIG_GD32_SERIAL_USART2_ALT_PC11_PC10 is not set
# CONFIG_GD32_SERIAL_USART2_ALT_PD9_PD8 is not set
CONFIG_SERIAL=y
CONFIG_SERIAL_BAUD=250000
CONFIG_USB_VENDOR_ID=0x1d50
CONFIG_USB_DEVICE_ID=0x614e
CONFIG_USB_SERIAL_NUMBER="12345"
CONFIG_WANT_ADC=y
CONFIG_WANT_HARD_PWM=y
CONFIG_WANT_BUTTONS=y
CONFIG_WANT_TMCUART=y
CONFIG_WANT_NEOPIXEL=y
CONFIG_WANT_PULSE_COUNTER=y
CONFIG_WANT_ST7920=y
CONFIG_WANT_HD44780=y
CONFIG_WANT_HX71X=y
CONFIG_NEED_SENSOR_BULK=y
CONFIG_WANT_LOAD_CELL_PROBE=y
CONFIG_NEED_SOS_FILTER=y
CONFIG_CANBUS_FREQUENCY=1000000
CONFIG_INLINE_STEPPER_HACK=y
CONFIG_HAVE_STEPPER_OPTIMIZED_BOTH_EDGE=y
CONFIG_WANT_STEPPER_OPTIMIZED_BOTH_EDGE=y
CONFIG_INITIAL_PINS=""
CONFIG_HAVE_GPIO=y
CONFIG_HAVE_GPIO_ADC=y
CONFIG_HAVE_GPIO_HARD_PWM=y
CONFIG_HAVE_CHIPID=y
CONFIG_HAVE_BOOTLOADER_REQUEST=y
```
